## src/modules/ceiling_controller/Kconfig
```kconfig
menuconfig MODULES_CEILING_CONTROLLER
	bool "ceiling_controller"
	default n
	---help---
		Enable the ceiling contact inspection controller for bridge-bottom UAV operations.
```

## src/modules/ceiling_reader/Kconfig
```kconfig
menuconfig MODULES_CEILING_READER
	bool "ceiling_reader"
	default n
	---help---
		Enable the CeilingReader module for ceiling contact sensor data processing.
```

## src/modules/uart_rx/Kconfig
```kconfig
menuconfig MODULES_UART_RX
	bool "uart_rx"
	default n
	---help---
		Enable the ESP32 UART receiver module for reading distance sensor frames.
```

## src/modules/uart_rx/Kconfig.kconfig
```kconfig
menuconfig EXAMPLES_UART_RX
	bool "uart_rx"
	default n
	---help---
		Enable the ESP32 UART receiver and esp32_uart_frame uORB publisher.

		The module defaults to /dev/ttyS4 at 115200 baud, which is TELEM2
		on the PX4 FMUv6X board. It accepts only complete frames in the format
		AA 55 payload[3] 0D 0A and publishes the raw 7-byte frame on uORB.
```
